/**
 * ESP32-CAM Snapshot Server
 * 
 * This program creates a web server on ESP32-CAM that serves:
 * - HTML page with camera preview
 * - JPEG snapshot endpoints
 * - Fallback AP mode when WiFi connection fails
 */
 
// Camera pin configuration (AI-THINKER module)

#include "esp_camera.h"
#include <WiFi.h>
#include <WebServer.h>

#define PWDN_GPIO_NUM     32
#define RESET_GPIO_NUM    -1
#define XCLK_GPIO_NUM      0
#define SIOD_GPIO_NUM     26
#define SIOC_GPIO_NUM     27
#define Y9_GPIO_NUM       35
#define Y8_GPIO_NUM       34
#define Y7_GPIO_NUM       39
#define Y6_GPIO_NUM       36
#define Y5_GPIO_NUM       21
#define Y4_GPIO_NUM       19
#define Y3_GPIO_NUM       18
#define Y2_GPIO_NUM        5
#define VSYNC_GPIO_NUM    25
#define HREF_GPIO_NUM     23
#define PCLK_GPIO_NUM     22

WebServer server(80);

const char* ssid = "Copper"; // WiFi hotspot configuration
const char* password = "12345678";

void setup() {
  Serial.begin(115200);
  delay(1000);
  Serial.println("\n\nStarting ESP32-CAM Snapshot Server");
  
  // OV3660 camera configuration
  camera_config_t config;
  config.ledc_channel = LEDC_CHANNEL_0;
  config.ledc_timer = LEDC_TIMER_0;
  config.pin_d0 = Y2_GPIO_NUM;
  config.pin_d1 = Y3_GPIO_NUM;
  config.pin_d2 = Y4_GPIO_NUM;
  config.pin_d3 = Y5_GPIO_NUM;
  config.pin_d4 = Y6_GPIO_NUM;
  config.pin_d5 = Y7_GPIO_NUM;
  config.pin_d6 = Y8_GPIO_NUM;
  config.pin_d7 = Y9_GPIO_NUM;
  config.pin_xclk = XCLK_GPIO_NUM;
  config.pin_pclk = PCLK_GPIO_NUM;
  config.pin_vsync = VSYNC_GPIO_NUM;
  config.pin_href = HREF_GPIO_NUM;
  config.pin_sscb_sda = SIOD_GPIO_NUM;
  config.pin_sscb_scl = SIOC_GPIO_NUM;
  config.pin_pwdn = PWDN_GPIO_NUM;
  config.pin_reset = RESET_GPIO_NUM;
  
  config.xclk_freq_hz = 20000000; // Clock for camera
  config.pixel_format = PIXFORMAT_JPEG;
  config.frame_size = FRAMESIZE_SVGA; // 800x600
  config.jpeg_quality = 10; //Medium quality (1-24) to ensure lower consumption of RAM  
  config.fb_count = 1;
  
  // Camera initialization
  esp_err_t err = esp_camera_init(&config);
  
  if (err == ESP_OK) {
    sensor_t *s = esp_camera_sensor_get();
    s->set_hmirror(s, 0);
    s->set_vflip(s, 1); // Configure camera orientation
    
    // Optimize for snapshot quality
    s->set_sharpness(s, 2);
    s->set_contrast(s, 1);
    s->set_brightness(s, 0);
    s->set_saturation(s, 0);
    s->set_whitebal(s, 1);
    s->set_exposure_ctrl(s, 1);
    
    Serial.println("[CAMERA] Camera initialized successfully");
  } else {
    Serial.println("[CAMERA] Camera initialization failed!");
    return;
  }
  

  WiFi.mode(WIFI_STA); //Initialize WiFi in STA mode
  Serial.println("\n[WIFI] Connecting to: " + String(ssid));
  WiFi.begin(ssid, password);
  
  int connectAttempts = 0; //Retry for 20 seconds before switching to AP.
  while (WiFi.status() != WL_CONNECTED && connectAttempts < 20) {
    delay(1000);
    Serial.print(".");
    connectAttempts++;
  }
  
  if (WiFi.status() == WL_CONNECTED) {
    Serial.println("\n[WIFI] Connected successfully!");
    Serial.println("[WIFI] ESP32-CAM Snapshot Server Ready");
    Serial.print("[WIFI] Local IP Address: ");
    Serial.println(WiFi.localIP());
    Serial.println("[WIFI] Snapshot URL: http://" + WiFi.localIP().toString() + "/jpg"); //Print IP and snapshot url for serial to capture.
  } else {
    Serial.println("\n[WIFI] Failed to connect to WiFi!");
    
    Serial.println("[WIFI] Starting fallback AP mode..."); //Switching to AP.
    
    //AP Config
    WiFi.mode(WIFI_AP);
    WiFi.softAP("ESP32-CAM-Fallback", "12345678");
    IPAddress myIP = WiFi.softAPIP();
    Serial.println("[WIFI] Fallback AP Mode Started");
    Serial.print("[WIFI] AP IP Address: ");
    Serial.println(myIP);
    Serial.println("[WIFI] Snapshot URL: http://" + myIP.toString() + "/jpg");
  }
  
  // Snapshot endpoint returns raw JPEG binary
  server.on("/jpg", HTTP_GET, []() {
    Serial.println("[SNAPSHOT] Request received");
    unsigned long startTime = millis();
    
    // Discard buffered frames to ensure fresh capture
    for (int i = 0; i < 2; i++) {
      camera_fb_t* discard_fb = esp_camera_fb_get();
      if (discard_fb) {
        esp_camera_fb_return(discard_fb);
        delay(30);
      }
    }
    
    // Capture fresh frame
    camera_fb_t *fb = esp_camera_fb_get();
    if (!fb) {
      server.send(500, "text/plain", "Camera capture failed");
      Serial.println("[SNAPSHOT] Capture failed - no frame buffer");
      return;
    }
    
    //Size Monitoring
    unsigned long captureTime = millis() - startTime;
    Serial.println("[SNAPSHOT] Frame captured, size: " + String(fb->len) + " bytes, time: " + String(captureTime) + "ms");
    
    // Send response headers
    server.client().flush();
    String response = "HTTP/1.1 200 OK\r\n";
    response += "Content-Type: image/jpeg\r\n";
    response += "Content-Length: " + String(fb->len) + "\r\n";
    response += "Cache-Control: no-cache, no-store, must-revalidate\r\n";
    response += "Pragma: no-cache\r\n";
    response += "Expires: 0\r\n";
    response += "Connection: close\r\n";
    response += "\r\n";
    
    server.client().write((const uint8_t *)response.c_str(), response.length());
    
    // Send JPEG binary data directly
    server.client().write(fb->buf, fb->len);
    server.client().flush();
    
    // Release frame buffer
    esp_camera_fb_return(fb);
    
    Serial.println("[SNAPSHOT] Image sent successfully");
  });
  
  // Alternative endpoint
  server.on("/snapshot", HTTP_GET, []() {
    server.client().flush();
    
    camera_fb_t *fb = esp_camera_fb_get();
    if (!fb) {
      server.send(500, "text/plain", "Camera capture failed");
      return;
    }
    
    String response = "HTTP/1.1 200 OK\r\n";
    response += "Content-Type: image/jpeg\r\n";
    response += "Content-Length: " + String(fb->len) + "\r\n";
    response += "Cache-Control: no-cache, no-store, must-revalidate\r\n";
    response += "Connection: close\r\n";
    response += "\r\n";
    
    server.client().write((const uint8_t *)response.c_str(), response.length());
    server.client().write(fb->buf, fb->len);
    server.client().flush();
    
    esp_camera_fb_return(fb);
  });
  
  // Root page with info and test image
  server.on("/", HTTP_GET, []() {
    String currentIP = (WiFi.status() == WL_CONNECTED) ? WiFi.localIP().toString() : WiFi.softAPIP().toString();
    String wifiMode = (WiFi.status() == WL_CONNECTED) ? "Connected to Hotspot" : "Fallback AP Mode";
    String connectedSSID = (WiFi.status() == WL_CONNECTED) ? String(ssid) : "ESP32-CAM-Fallback";
    
    //Webpage styling
    String html = "<!DOCTYPE html><html><head><title>ESP32-CAM Snapshot</title>";
    html += "<meta charset='UTF-8'>";
    html += "<meta name='viewport' content='width=device-width, initial-scale=1'>";
    html += "<style>";
    html += "body{font-family:Arial,sans-serif;text-align:center;margin:20px;background:#f5f5f5;}";
    html += ".container{max-width:800px;margin:0 auto;background:white;padding:20px;border-radius:8px;box-shadow:0 2px 4px rgba(0,0,0,0.1);}";
    html += ".info{background:#e8f4f8;padding:15px;border-radius:5px;margin:15px 0;text-align:left;}";
    html += ".info p{margin:8px 0;}";
    html += ".code{background:#f0f0f0;padding:8px;border-radius:3px;font-family:monospace;overflow-x:auto;}";
    html += "img{max-width:100%;height:auto;border:1px solid #ddd;border-radius:5px;margin:15px 0;}";
    html += "button{background:#007bff;color:white;border:none;padding:10px 20px;border-radius:5px;cursor:pointer;font-size:16px;}";
    html += "button:hover{background:#0056b3;}";
    html += ".status{background:#d4edda;color:#155724;padding:10px;border-radius:5px;margin:10px 0;}";
    html += ".warning{background:#fff3cd;color:#856404;padding:10px;border-radius:5px;margin:10px 0;}";
    html += "</style></head>";
    html += "<body><div class='container'>";
    html += "<h1>🎥 ESP32-CAM Snapshot Server</h1>";
    
    //WiFi Mode
    if (WiFi.status() == WL_CONNECTED) {
      html += "<div class='status'> Connected to Phone Hotspot</div>";
    } else {
      html += "<div class='warning'>  Using Fallback AP Mode</div>";
    }
    
    // WiFi Display
    html += "<div class='info'>";
    html += "<p><strong>WiFi Mode:</strong> " + wifiMode + "</p>";
    html += "<p><strong>Network:</strong> " + connectedSSID + "</p>";
    html += "<p><strong>IP Address:</strong> " + currentIP + "</p>";
    html += "</div>";
    
    // Live preview section
    html += "<h2>Live Preview</h2>";
    html += "<button onclick='location.reload()'> Refresh Image</button>";
    html += "<div><img src='/jpg' id='stream' alt='Snapshot Preview'></div>";
    
    // IP display
    html += "<h2>API Endpoints</h2>";
    html += "<div class='info'>";
    html += "<p><strong>JPEG Snapshot:</strong></p>";
    html += "<div class='code'>http://" + currentIP + "/jpg</div>";
    html += "<p style='margin-top:10px;'><strong>Alternative endpoint:</strong></p>";
    html += "<div class='code'>http://" + currentIP + "/snapshot</div>";
    html += "</div>";
    
    html += "<p style='color:#666;font-size:14px;margin-top:20px;'>Use these URLs to capture images from your IoT device</p>";
    html += "</div></body></html>";
    
    server.send(200, "text/html", html);
  });
  
  // Start server
  server.begin();
  Serial.println("[WIFI] HTTP server started on port 80\n");
}

void loop() {
  server.handleClient();
  delay(1);
}
